#include <msp430.h>
#include <stdint.h>

#include "ink.h"

// Profiling flags.
#if RAISE_PIN
__nv uint8_t full_run_started = 0;
__nv uint8_t first_run        = 1;
#endif

#define LENGTH 100

const uint16_t a1[LENGTH] = {
    3,   1,   4,   6,   9,   5,   10,  8,   16,  20,  19,  40,  16,  17,  2,   41,  80,  100, 5,   89,  66,  77,  8,
    3,   32,  55,  8,   11,  99,  65,  25,  89,  3,   22,  25,  121, 11,  90,  74,  1,   12,  39,  54,  20,  22,  43,
    45,  90,  81,  40,  3,   1,   4,   6,   9,   5,   10,  8,   16,  20,  19,  40,  16,  17,  2,   41,  80,  100, 5,
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    81,  40,
};

const uint16_t a2[] = {
    121, 177, 50,  55,  32,  173, 164, 132, 17,  174, 61,  186, 96,  44,  120, 181, 24,  134, 68,  167, 8,   26,  144,
    138, 133, 48,  80,  60,  39,  6,   86,  126, 154, 42,  150, 113, 105, 52,  139, 175, 58,  98,  31,  182, 74,  169,
    4,   23,  157, 189, 72,  130, 9,   19,  12,  67,  2,   16,  49,  57,  69,  94,  145, 136, 99,  152, 198, 59,  153,
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    81,  40,
};

// Tasks.
ENTRY_TASK(task_init);
TASK(task_inner_loop);
TASK(task_outer_loop);
TASK(task_finish);

// Task-shared protected variables.
__shared(
    uint16_t array[LENGTH];
    uint16_t outer_idx;
    uint16_t inner_idx;
    uint8_t iteration;
)

// called at the very first boot
void thread1_init()
{
    // create a thread with priority 15 and entry task t_init
    __CREATE(15, task_init);
    __SIGNAL(15);
}

__app_reboot()
{
#ifdef RAISE_PIN
    __port_init(3, 4);
#else
    __no_operation();
#endif
}

ENTRY_TASK(task_init)
{
#if RAISE_PIN
    full_run_started = 1;
#endif

    __SET(outer_idx, 0);
    __SET(inner_idx, 1);

    const uint16_t* array_pt;

    __SET(iteration, ++__GET(iteration));
    if (__GET(iteration) & 0x01)
    {
        array_pt = a1;
    }
    else
    {
        array_pt = a2;
    }

    uint16_t idx;
    for (idx = 0; idx < LENGTH; idx++)
    {
        __SET(array[idx], array_pt[idx]);
    }

    return task_inner_loop;
}

TASK(task_inner_loop)
{
    uint16_t i, j, x_i, x_j, temp;

    i = __GET(outer_idx);
    j = __GET(inner_idx);

    x_i = __GET(array[i]);
    x_j = __GET(array[j]);

    if (x_i > x_j)
    {
        temp = x_j;
        x_j  = x_i;
        x_i  = temp;
    }

    __SET(array[i], x_i);
    __SET(array[j], x_j);
    __SET(inner_idx, ++__GET(inner_idx));

    if (__GET(inner_idx) < LENGTH)
    {
        return task_inner_loop;
    }
    else
    {
        return task_outer_loop;
    }
}

TASK(task_outer_loop)
{
    __SET(outer_idx, ++__GET(outer_idx));
    __SET(inner_idx, __GET(outer_idx) + 1);

    if (__GET(outer_idx) < LENGTH - 1)
    {
        return task_inner_loop;
    }
    else
    {
        return task_finish;
    }
}

TASK(task_finish)
{
#if RAISE_PIN
    if (full_run_started)
    {
        __port_on(3, 4);
        __port_off(3, 4);
        full_run_started = 0;
    }
#endif

    return task_init;
}
