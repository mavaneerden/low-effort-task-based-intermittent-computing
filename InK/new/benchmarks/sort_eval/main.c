#include <msp430.h>
#include <stdint.h>

#include "benchmark_helpers.h"
#include "ink/ink.h"

// Profiling flags.
#if RAISE_PIN
INK_PERSISTENT uint8_t full_run_started = 0;
INK_PERSISTENT uint8_t first_run        = 1;
#endif

#define LENGTH 100

const uint16_t a1[LENGTH] = {
    3,   1,   4,   6,   9,   5,   10,  8,   16,  20,  19,  40,  16,  17,  2,   41,  80,  100, 5,   89,  66,  77,  8,
    3,   32,  55,  8,   11,  99,  65,  25,  89,  3,   22,  25,  121, 11,  90,  74,  1,   12,  39,  54,  20,  22,  43,
    45,  90,  81,  40,  3,   1,   4,   6,   9,   5,   10,  8,   16,  20,  19,  40,  16,  17,  2,   41,  80,  100, 5,
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    81,  40,
};

const uint16_t a2[] = {
    121, 177, 50,  55,  32,  173, 164, 132, 17,  174, 61,  186, 96,  44,  120, 181, 24,  134, 68,  167, 8,   26,  144,
    138, 133, 48,  80,  60,  39,  6,   86,  126, 154, 42,  150, 113, 105, 52,  139, 175, 58,  98,  31,  182, 74,  169,
    4,   23,  157, 189, 72,  130, 9,   19,  12,  67,  2,   16,  49,  57,  69,  94,  145, 136, 99,  152, 198, 59,  153,
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    81,  40,
};

// Tasks.
static void* task_inner_loop();
static void* task_outer_loop();
static void* task_finish();

// Task-shared protected variables.
uint16_t array[LENGTH];
uint16_t outer_idx;
uint16_t inner_idx;
uint8_t  iteration;

INK_CREATE_THREAD(15, true)
{
#if RAISE_PIN
    full_run_started = 1;
#endif

    outer_idx = 0;
    inner_idx = 1;

    const uint16_t* array_pt;

    ++iteration;
    if (iteration & 0x01)
    {
        array_pt = a1;
    }
    else
    {
        array_pt = a2;
    }

    uint16_t idx;
    for (idx = 0; idx < LENGTH; idx++)
    {
        array[idx] = array_pt[idx];
    }

    return task_inner_loop;
}

static void* task_inner_loop()
{
    uint16_t i, j, x_i, x_j, temp;

    i = outer_idx;
    j = inner_idx;

    x_i = array[i];
    x_j = array[j];

    if (x_i > x_j)
    {
        temp = x_j;
        x_j  = x_i;
        x_i  = temp;
    }

    array[i] = x_i;
    array[j] = x_j;
    ++inner_idx;

    if (inner_idx < LENGTH)
    {
        return task_inner_loop;
    }
    else
    {
        return task_outer_loop;
    }
}

static void* task_outer_loop()
{
    ++outer_idx;
    inner_idx = outer_idx + 1;

    if (outer_idx < LENGTH - 1)
    {
        return task_inner_loop;
    }
    else
    {
        return task_finish;
    }
}

static void* task_finish()
{
#if RAISE_PIN
    if (full_run_started)
    {
        __port_on(3, 4);
        __port_off(3, 4);
        full_run_started = 0;
    }
#endif

    return INK_THREAD_ENTRY_TASK;
}

int main(void)
{
    /*** Things to do after reboot. ***/
    WDTCTL   = WDTPW | WDTHOLD;  // Stop watchdog timer
    PM5CTL0 &= ~LOCKLPM5;        // Disable the GPIO power-on default high-impedance mode

#ifdef RAISE_PIN
    __port_init(3, 4);  // Initialize the pin so we can read the timing.
#endif

    /* Start the scheduler. */
    ink_scheduler_run();

    return 0;
}
